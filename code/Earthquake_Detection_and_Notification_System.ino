#include <SPI.h>
#include <Wire.h>
#include <WiFi.h>
#include <Arduino.h>
#include <HTTPClient.h>
#include <Adafruit_GFX.h>
#include <HardwareSerial.h>
#include <Adafruit_SSD1306.h>
#include <WiFiClientSecure.h>
#include <DFRobotDFPlayerMini.h>
#include <UniversalTelegramBot.h>

#define SCREEN_WIDTH 128
#define SCREEN_HEIGHT 64
#define OLED_RESET -1
#define SCREEN_ADDRESS 0x3C
#define BUTTON_PIN 4
#define POWER 2
#define ALARM 18

Adafruit_SSD1306 display(SCREEN_WIDTH, SCREEN_HEIGHT, &Wire, OLED_RESET);

// ADXL335 pins
const int xPin = 34;
const int yPin = 35;
const int zPin = 32;

HardwareSerial SIM800(0); 
const int RX_PIN = 3;
const int TX_PIN = 1;

int button = 1;

int xData[SCREEN_WIDTH];
int yData[SCREEN_WIDTH];
int zData[SCREEN_WIDTH];

HardwareSerial mySerial(2);
DFRobotDFPlayerMini myDFPlayer;

const int busyPin = 14;

/*variables*/
int xsample = 0;
int ysample = 0;
int zsample = 0;
long start;

/*Macros*/
#define samples 50
#define maxVal 250 
#define minVal -250 

int person = 0;
int j;
bool isPlaying = false;           // Flag to indicate if the audio is currently playing
bool earthquakeState = false;     // State of earthquake detection
unsigned long lastDebounceTime = 0;
const unsigned long debounceDelay = 500; // Debounce delay in milliseconds

// Earthquake detection stability parameters
int consecutiveEarthquakeReadings = 0;
const int requiredConsecutiveReadings = 3;

const uint16_t interval = 100; // Interval between images in milliseconds
uint32_t previousMillis = 0;
int currentImage = 0;

String phoneNumbers[] = {"+639390147627","+639300175858"}; 

const char* ssid = "WIFI NAME";
const char* password = "WIFI PASSWORD";

const String botToken = "7464554791:AAGxbAAL2HIvTmdVmfDPkqVO2mbPcLa0MEU";  //telegran bot token
String chatIDs[] = {
  "5292201469", 
  "1261913509",
  "1173318892",
  "6926535285"
}; //telegram chat id
int numChatIDs = sizeof(chatIDs) / sizeof(chatIDs[0]);

WiFiClientSecure client;
UniversalTelegramBot bot(botToken, client);

const unsigned char message_3 [] PROGMEM = {
	0x00, 0x00, 0x00, 0x00, 0x00, 0x00, 0x00, 0x00, 0x00, 0x00, 0x00, 0x00, 0x00, 0x00, 0x00, 0x00, 
	0x00, 0x00, 0x00, 0x00, 0x00, 0x00, 0x00, 0x00, 0x00, 0x00, 0x00, 0x00, 0x00, 0x00, 0x00, 0x00, 
	0x00, 0x00, 0x00, 0x00, 0x00, 0x00, 0x00, 0x00, 0x00, 0x00, 0x00, 0x00, 0x00, 0x00, 0x00, 0x00, 
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	0x00, 0x00, 0x00, 0x00, 0x00, 0x00, 0x00, 0x00, 0x00, 0x00, 0x00, 0x00, 0x00, 0x00, 0x00, 0x00
};

const unsigned char pylon1 [] PROGMEM = {
	0x00, 0x00, 0x00, 0x00, 0x00, 0x00, 0x00, 0x00, 0x00, 0x00, 0x00, 0x00, 0x00, 0x00, 0x00, 0x00, 
	0x00, 0x00, 0x00, 0x00, 0x00, 0x00, 0x00, 0x00, 0x00, 0x00, 0x00, 0x00, 0x00, 0x00, 0x00, 0x00, 
	0x00, 0x00, 0x00, 0x00, 0x00, 0x00, 0x00, 0x00, 0x00, 0x00, 0x00, 0x00, 0x00, 0x00, 0x00, 0x00, 
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	0x00, 0x00, 0x00, 0x00, 0x00, 0x00, 0x00, 0x00, 0x00, 0x00, 0x00, 0x00, 0x00, 0x00, 0x00, 0x00
};

const unsigned char pylon2 [] PROGMEM = {
	0x00, 0x00, 0x00, 0x00, 0x00, 0x00, 0x00, 0x00, 0x00, 0x00, 0x00, 0x00, 0x00, 0x00, 0x00, 0x00, 
	0x00, 0x00, 0x00, 0x00, 0x00, 0x00, 0x00, 0x00, 0x00, 0x00, 0x00, 0x00, 0x00, 0x00, 0x00, 0x00, 
	0x00, 0x00, 0x00, 0x00, 0x00, 0x00, 0x00, 0x00, 0x00, 0x00, 0x00, 0x00, 0x00, 0x00, 0x00, 0x00, 
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	0x00, 0x00, 0x00, 0x03, 0xff, 0xfe, 0x00, 0x00, 0x00, 0x00, 0x00, 0x00, 0x00, 0x00, 0x00, 0x00
};

const unsigned char pylon3 [] PROGMEM = {
	0x00, 0x00, 0x00, 0x00, 0x00, 0x00, 0x00, 0x00, 0x00, 0x00, 0x00, 0x00, 0x00, 0x00, 0x00, 0x00, 
	0x00, 0x00, 0x00, 0x00, 0x00, 0x00, 0x00, 0x00, 0x00, 0x00, 0x00, 0x00, 0x00, 0x00, 0x00, 0x00, 
	0x00, 0x00, 0x00, 0x00, 0x00, 0x00, 0x00, 0x00, 0x00, 0x00, 0x00, 0x00, 0x00, 0x00, 0x00, 0x00, 
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	0x00, 0x00, 0x00, 0x00, 0x00, 0x3f, 0xff, 0xff, 0xff, 0xff, 0xff, 0xe0, 0x00, 0x00, 0x00, 0x00
};

const unsigned char pylon4 [] PROGMEM = {
	0x00, 0x00, 0x00, 0x00, 0x00, 0x00, 0x00, 0x00, 0x00, 0x00, 0x00, 0x00, 0x00, 0x00, 0x00, 0x00, 
	0x00, 0x00, 0x00, 0x00, 0x00, 0x00, 0x00, 0x00, 0x00, 0x00, 0x00, 0x00, 0x00, 0x00, 0x00, 0x00, 
	0x00, 0x00, 0x00, 0x00, 0x00, 0x00, 0x00, 0x00, 0x00, 0x00, 0x00, 0x00, 0x00, 0x00, 0x00, 0x00, 
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	0x00, 0x00, 0x0f, 0xff, 0xff, 0xff, 0xf8, 0xff, 0xff, 0xff, 0xff, 0xf0, 0x00, 0x00, 0x00, 0x00
};

const unsigned char pylon5 [] PROGMEM = {
	0x00, 0x00, 0x00, 0x00, 0x00, 0x00, 0x00, 0x00, 0x00, 0x00, 0x00, 0x00, 0x00, 0x00, 0x00, 0x00, 
	0x00, 0x00, 0x00, 0x00, 0x00, 0x00, 0x00, 0x00, 0x00, 0x00, 0x00, 0x00, 0x00, 0x00, 0x00, 0x00, 
	0x00, 0x00, 0x00, 0x00, 0x00, 0x00, 0x00, 0x00, 0x00, 0x00, 0x00, 0x00, 0x00, 0x00, 0x00, 0x00, 
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	0x00, 0x00, 0x00, 0x00, 0x03, 0xff, 0xf8, 0x1e, 0x0e, 0x3f, 0xff, 0xff, 0x9f, 0xff, 0xff, 0x00
};

const unsigned char pylon6 [] PROGMEM = {
	0x00, 0x00, 0x00, 0x00, 0x00, 0x00, 0x00, 0x00, 0x00, 0x00, 0x00, 0x00, 0x00, 0x00, 0x00, 0x00, 
	0x00, 0x00, 0x00, 0x00, 0x00, 0x00, 0x00, 0x00, 0x00, 0x00, 0x00, 0x00, 0x00, 0x00, 0x00, 0x00, 
	0x00, 0x00, 0x00, 0x00, 0x00, 0x00, 0x00, 0x00, 0x00, 0x00, 0x00, 0x00, 0x00, 0x00, 0x00, 0x00, 
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	0x00, 0x00, 0x07, 0xff, 0xe0, 0x1f, 0xfe, 0x3f, 0x83, 0xf3, 0x8f, 0x83, 0xff, 0x80, 0x00, 0x00
};

const unsigned char pylon7 [] PROGMEM = {
	0x00, 0x00, 0x00, 0x00, 0x00, 0x00, 0x00, 0x00, 0x00, 0x00, 0x00, 0x00, 0x00, 0x00, 0x00, 0x00, 
	0x00, 0x00, 0x00, 0x00, 0x00, 0x00, 0x00, 0x00, 0x00, 0x00, 0x00, 0x00, 0x00, 0x00, 0x00, 0x00, 
	0x00, 0x00, 0x00, 0x00, 0x00, 0x00, 0x00, 0x00, 0x00, 0x00, 0x00, 0x00, 0x00, 0x00, 0x00, 0x00, 
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	0x00, 0x00, 0x00, 0x00, 0xff, 0xff, 0xff, 0xff, 0xe3, 0xff, 0xf8, 0xfc, 0xfe, 0x08, 0x1c, 0x00
};

const unsigned char pylon8 [] PROGMEM = {
	0x00, 0x00, 0x00, 0x00, 0x00, 0x00, 0x00, 0x00, 0x00, 0x00, 0x00, 0x00, 0x00, 0x00, 0x00, 0x00, 
	0x00, 0x00, 0x00, 0x00, 0x00, 0x00, 0x00, 0x00, 0x00, 0x00, 0x00, 0x00, 0x00, 0x00, 0x00, 0x00, 
	0x00, 0x00, 0x00, 0x00, 0x00, 0x00, 0x00, 0x00, 0x00, 0x00, 0x00, 0x00, 0x00, 0x00, 0x00, 0x00, 
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	0x00, 0x00, 0x07, 0xff, 0xff, 0xff, 0xff, 0x1f, 0xff, 0xff, 0xe7, 0xe0, 0x7f, 0xf0, 0x00, 0x00
};

const unsigned char pylon9 [] PROGMEM = {
	0x00, 0x00, 0x00, 0x00, 0x00, 0x00, 0x00, 0x00, 0x00, 0x00, 0x00, 0x00, 0x00, 0x00, 0x00, 0x00, 
	0x00, 0x00, 0x00, 0x00, 0x00, 0x00, 0x00, 0x00, 0x00, 0x00, 0x00, 0x00, 0x00, 0x00, 0x00, 0x00, 
	0x00, 0x00, 0x00, 0x00, 0x00, 0x00, 0x00, 0x00, 0x00, 0x00, 0x00, 0x00, 0x00, 0x00, 0x00, 0x00, 
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	0x00, 0x00, 0x00, 0x7f, 0xff, 0xff, 0xff, 0xf1, 0xff, 0xff, 0xfe, 0x3f, 0xff, 0xff, 0x00, 0x00
};

const unsigned char quick [] PROGMEM = {
	0x00, 0x00, 0x00, 0x00, 0x00, 0x00, 0x00, 0x00, 0x00, 0x00, 0x00, 0x00, 0x00, 0x00, 0x00, 0x00, 
	0x00, 0x00, 0x00, 0x00, 0x00, 0x00, 0x00, 0x00, 0x00, 0x00, 0x00, 0x00, 0x00, 0x00, 0x00, 0x00, 
	0x00, 0x00, 0x00, 0x00, 0x00, 0x00, 0x00, 0x00, 0x00, 0x00, 0x00, 0x00, 0x00, 0x00, 0x00, 0x00, 
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	0x00, 0x00, 0x00, 0x00, 0x00, 0x00, 0x00, 0x00, 0x00, 0x00, 0x00, 0x00, 0x00, 0x00, 0x00, 0x00
};

unsigned long lastMessageCheck = 0;
const unsigned long messageCheckInterval = 10000; // Check for new messages every 10 seconds

void setup()
{
    Serial.begin(115200);
    SIM800.begin(9600, SERIAL_8N1, RX_PIN, TX_PIN);

    // Initialize OLED display
    if (!display.begin(SSD1306_SWITCHCAPVCC, SCREEN_ADDRESS)){
        Serial.println(F("SSD1306 allocation failed"));
        for (;;);
    }
    display.display();
    delay(2000); // Pause for 2 seconds

    display.clearDisplay();

    mySerial.begin(9600, SERIAL_8N1, 16, 17); // Initialize Serial2 of tx rx

    pinMode(busyPin, INPUT);

    Serial.println();
    Serial.println(F("Initializing DFPlayer..."));

    if (!myDFPlayer.begin(mySerial))
    { // Use softwareSerial to communicate with mp3.
        Serial.println(F("Unable to begin:"));
        Serial.println(F("1. Please recheck the connection!"));
        Serial.println(F("2. Please insert the SD card!"));
        while (true)
            ;
    }

    Serial.println(F("DFPlayer Mini online."));

    loading();

    for (int i = 0; i < samples; i++) // taking samples for calibration
    {
        xsample += analogRead(xPin);
        ysample += analogRead(yPin);
        zsample += analogRead(zPin);
    }

    xsample /= samples; // taking avg for x
    ysample /= samples; // taking avg for y
    zsample /= samples; // taking avg for z

    pinMode(BUTTON_PIN, INPUT_PULLUP);
    pinMode(POWER, OUTPUT);
    pinMode(ALARM, OUTPUT);

    WiFi.begin(ssid, password);
    while (WiFi.status() != WL_CONNECTED) {
      delay(1000);
      Serial.println("Connecting to WiFi...");
    }
    Serial.println("Connected to WiFi");
    client.setInsecure();
    digitalWrite(POWER, HIGH);
}

void loop() {
    seismograph();
    alarm();

    unsigned long currentMillis = millis();
    if (currentMillis - lastMessageCheck >= messageCheckInterval) {
        lastMessageCheck = currentMillis;
        reply();
    }
}

void seismograph(){
    static unsigned long lastUpdate = 0;
    unsigned long currentMillis = millis();

    if (currentMillis - lastUpdate >= 100) { // Adjust the update interval as needed
        lastUpdate = currentMillis;

        // Read accelerometer values
        int xValue = analogRead(xPin);
        int yValue = analogRead(yPin);
        int zValue = analogRead(zPin);

        // Map the raw values to the display height
        int xMapped = map(xValue, 0, 4095, 0, SCREEN_HEIGHT - 1);
        int yMapped = map(yValue, 0, 4095, 0, SCREEN_HEIGHT - 1);
        int zMapped = map(zValue, 0, 4095, 0, SCREEN_HEIGHT - 1);

        // Shift the data in the buffers to make room for the new values
        for (int i = SCREEN_WIDTH - 1; i > 0; i--)
        {
            xData[i] = xData[i - 1];
            yData[i] = yData[i - 1];
            zData[i] = zData[i - 1];
        }
        xData[0] = xMapped;
        yData[0] = yMapped;
        zData[0] = zMapped;

        // Clear the display and draw the graphs
        display.clearDisplay();

        // x-axis graph
        for (int i = 1; i < SCREEN_WIDTH; i++)
        {
            display.drawLine(i - 1 + 10, SCREEN_HEIGHT - xData[i - 1] - 29, i + 10, SCREEN_HEIGHT - xData[i] - 29, SSD1306_WHITE);
        }

        // y-axis graph
        for (int i = 1; i < SCREEN_WIDTH; i++)
        {
            display.drawLine(i - 1 + 10, SCREEN_HEIGHT - yData[i - 1] - 5, i + 10, SCREEN_HEIGHT - yData[i] - 5, SSD1306_WHITE);
        }

        // z-axis graph
        for (int i = 1; i < SCREEN_WIDTH; i++)
        {
            display.drawLine(i - 1 + 10, SCREEN_HEIGHT - zData[i - 1] + 25, i + 10, SCREEN_HEIGHT - zData[i] + 25, SSD1306_WHITE);
        }

        // x y z labels
        display.setCursor(0, 5);
        display.setTextSize(1);
        display.setTextColor(SSD1306_WHITE);
        display.print("X");
        display.setCursor(0, 27);
        display.print("Y");
        display.setCursor(0, 52);
        display.print("Z");

        display.display();
    }
}

void sending_animation(){
  display.clearDisplay();

  display.drawBitmap(0, 0,  message_3, 128, 64, WHITE);
  display.display();
  delay(50);
}

void alarm() {
    int value1 = analogRead(xPin); // reading x out
    int value2 = analogRead(yPin); // reading y out
    int value3 = analogRead(zPin); // reading z out

    int xValue = xsample - value1; // finding change in x
    int yValue = ysample - value2; // finding change in y
    int zValue = zsample - value3; // finding change in z

    // Check if earthquake conditions are met
    bool earthquakeDetected = (xValue < minVal || xValue > maxVal || yValue < minVal || yValue > maxVal || zValue < minVal || zValue > maxVal);

    if (earthquakeDetected) {
        consecutiveEarthquakeReadings++;
        if (consecutiveEarthquakeReadings >= requiredConsecutiveReadings) {
            earthquakeState = true;
            consecutiveEarthquakeReadings = 0;
        }
    } else {
        consecutiveEarthquakeReadings = 0;
    }

    if (earthquakeState) {
        if (!isPlaying) {
            myDFPlayer.volume(30); // volume (0~30).
            myDFPlayer.loop(1);    // play the first audio file in loop mode
            isPlaying = true;
            Serial.println("earthquake");
            digitalWrite(ALARM, HIGH);
            sending_animation();
            sendMessage("URGENT: Earthquake Alert! Seek shelter immediately! Move to a safe place away from windows, shelves, and heavy objects that could fall. Stay safe!");
            sendMessage("URGENT: Earthquake Alert! Seek shelter immediately! Perform DUCK, COVER, AND HOLD!!");
            sendMessage("THIS IS AN EMERGENCY!!!");
        }
    } else {
        if (isPlaying) {
            myDFPlayer.stop(); // stop playing audio
            isPlaying = false;
            Serial.println("no earthquake");
        }
    }

    // If the button is pressed, stop the audio
    button = digitalRead(BUTTON_PIN);
    if (button == LOW) {
        myDFPlayer.stop(); // stop playing audio
        myDFPlayer.volume(30); // volume (0~30).
        myDFPlayer.loop(2); 
        digitalWrite(ALARM, LOW); // turn off the alarm LED
        earthquakeState = false; // reset earthquake state
        button = HIGH;
        if (button == LOW){
            myDFPlayer.stop();
            digitalWrite(ALARM, LOW);
            isPlaying = false; // reset the playing flag
        }
    }
}

void loading(){
  display.clearDisplay();

  display.drawBitmap(0, 0,  pylon1, 128, 64, WHITE);
  display.display();
  delay(100);

  display.clearDisplay();

  display.drawBitmap(0, 0,  pylon2, 128, 64, WHITE);
  display.display();
  delay(100);

  display.clearDisplay();

  display.drawBitmap(0, 0,  pylon3, 128, 64, WHITE);
  display.display();
  delay(100);

  display.clearDisplay();

  display.drawBitmap(0, 0,  pylon4, 128, 64, WHITE);
  display.display();
  delay(100);

  display.clearDisplay();

  display.drawBitmap(0, 0,  pylon5, 128, 64, WHITE);
  display.display();
  delay(100);

  display.clearDisplay();

  display.drawBitmap(0, 0,  pylon6, 128, 64, WHITE);
  display.display();
  delay(100);

  display.clearDisplay();

  display.drawBitmap(0, 0,  pylon7, 128, 64, WHITE);
  display.display();
  delay(100);

  display.clearDisplay();

  display.drawBitmap(0, 0,  pylon8, 128, 64, WHITE);
  display.display();
  delay(100);

  display.clearDisplay();

  display.drawBitmap(0, 0,  pylon9, 128, 64, WHITE);
  display.display();
  delay(2000);

  display.clearDisplay();

  display.drawBitmap(0, 0,  quick, 128, 64, WHITE);
  display.display();
  delay(1500);
}

void sendMessage(String message) {
  if(WiFi.status() == WL_CONNECTED) {
    for (int i = 0; i < numChatIDs; i++) {
      HTTPClient http;
      String url = "https://api.telegram.org/bot" + botToken + "/sendMessage?chat_id=" + chatIDs[i] + "&text=" + message;

      http.begin(url);
      int httpResponseCode = http.GET();

      if (httpResponseCode > 0) {
        String response = http.getString();
        Serial.println(httpResponseCode);
        Serial.println(response);
      } else {
        Serial.print("Error on sending POST: ");
        Serial.println(httpResponseCode);
      }

      http.end();
    }
  } else {
    Serial.println("WiFi Disconnected");
  }
}

void handleNewMessages(int numNewMessages) {
    Serial.print("Handling ");
    Serial.print(numNewMessages);
    Serial.println(" new messages");
    
    for (int i = 0; i < numNewMessages; i++) {
        String chat_id = String(bot.messages[i].chat_id);
        String text = bot.messages[i].text;

        Serial.print("Received message from chat_id: ");
        Serial.println(chat_id);
        Serial.print("Message text: ");
        Serial.println(text);

        if (text == "/start") {
            bot.sendMessage(chat_id, "Welcome to the Earthquake Alert Bot! Stay safe with real-time earthquake updates and safety tips.", "");
        }
        if (text == "/safetytips") {
            bot.sendMessage(chat_id, "Earthquake Safety Tips:\n1. Drop, Cover, Hold On: Drop to your hands and knees, cover your head and neck, and hold on until shaking stops.\n2. Stay Indoors: Move away from windows and heavy objects. Take shelter under sturdy furniture.\n3. If Outside: Move to an open area away from buildings, trees, and power lines.\n4. Avoid Elevators: Use stairs if you need to evacuate.\n5. Stay Calm: Keep calm and reassure others around you.", "");
        }
        if (text == "/stop_all") {
            bot.sendMessage(chat_id, "The all alarms has been stopped. The system will continue to monitor for new earthquakes.", "");
            myDFPlayer.stop();
            isPlaying = false;
            digitalWrite(ALARM, LOW);
            earthquakeState = false; // Ensure earthquakeState is reset
        }
        if (text == "/stop1") {
            bot.sendMessage(chat_id, "First alarm has been stopped. Now playing Alarm2", "");
            myDFPlayer.stop();
            myDFPlayer.volume(30); // volume (0~30).
            myDFPlayer.loop(2); 
            digitalWrite(ALARM, LOW);
            earthquakeState = false; // Ensure earthquakeState is reset
        }
        if (text == "/stop2") {
            bot.sendMessage(chat_id, "Alarm2 has been stopped.", "");
            myDFPlayer.stop();
            isPlaying = false;
            digitalWrite(ALARM, LOW);
            earthquakeState = false; // Ensure earthquakeState is reset
        }
        if (text == "taenamo") {
            bot.sendMessage(chat_id, "Taenamo rin!!!", "");
        }
        if (text == "/play_alarm1") {
            bot.sendMessage(chat_id, "First alarm is playing", "");
            myDFPlayer.volume(30); // volume (0~30).
            myDFPlayer.loop(1); 
            digitalWrite(ALARM, LOW);
            earthquakeState = false;
        }
    }
}

void reply() {
    if (WiFi.status() == WL_CONNECTED) {
        int numNewMessages = bot.getUpdates(bot.last_message_received + 1);
        if (numNewMessages > 0) {
            handleNewMessages(numNewMessages);
        }
    } else {
        Serial.println("WiFi Disconnected");
    }
}
